## conf/layer.conf
```bitbake
# We have a conf and classes directory, add to BBPATH
BBPATH .= ":${LAYERDIR}"

# We have recipes-* directories, add to BBFILES
BBFILES += "${LAYERDIR}/recipes-*/*/*.bb \
            ${LAYERDIR}/recipes-*/*/*.bbappend"

BBFILE_COLLECTIONS += "meta-n3z"
BBFILE_PATTERN_meta-n3z = "^${LAYERDIR}/"
BBFILE_PRIORITY_meta-n3z = "6"

LAYERDEPENDS_meta-n3z = "core"
LAYERSERIES_COMPAT_meta-n3z = "thud warrior"
```
